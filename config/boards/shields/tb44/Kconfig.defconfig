## config/boards/shields/tb44/Kconfig.defconfig
```kconfig
if SHIELD_MT42

config ZMK_POINTING
  default y

config PAW3222
  default y

config ZMK_KEYBOARD_NAME
default "mt42"

endif
```

## config/west.yml
```yaml
manifest:
  remotes:
    - name: zmkfirmware
      url-base: https://github.com/zmkfirmware
    - name: os55010
      url-base: https://github.com/os55010
  projects:
    - name: zmk
      remote: zmkfirmware
      revision: main
      import: app/west.yml
    - name: zmk-driver-paw3222
      remote: os55010
      revision: main
  self:
    path: config
```
